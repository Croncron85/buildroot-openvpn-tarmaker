## defconfig
```kconfig
BR2_x86_64=y
# BR2_UCLIBC_INSTALL_UTILS is not set
BR2_ROOTFS_POST_BUILD_SCRIPT="docker/openvpn/post.sh"
BR2_PACKAGE_IPTABLES=y
BR2_PACKAGE_OPENVPN=y
BR2_PACKAGE_OPENVPN_SMALL=y
```
